## CMakeLists.txt
```
#
# Copyright (c) 2024 Nordic Semiconductor ASA
#
# SPDX-License-Identifier: LicenseRef-Nordic-5-Clause
#
cmake_minimum_required(VERSION 3.20.0)

find_package(Zephyr REQUIRED HINTS $ENV{ZEPHYR_BASE})
project(nrf_thingy_env_monitor_tests)

# Test source files with mocking framework
target_sources(app PRIVATE
    src/test_main.c
    src/test_battery_service.c
    src/test_ess_service.c
    src/test_mock_framework.c
    src/test_sensor_manager.c
    src/test_sensor_manager_policy.c
    src/mocks/mock_i2c.c
    src/mocks/mock_gpio.c
    src/mocks/mock_sensor.c
    src/mocks/mock_bluetooth.c
)

# Include directories for tests
target_include_directories(app PRIVATE 
    src
    src/mocks
    ../include
)
```

## prj.conf
```kconfig
# ZTEST Framework
CONFIG_ZTEST=y
CONFIG_ZTEST_VERBOSE_OUTPUT=y

# Use external (host) libc for native_sim
CONFIG_EXTERNAL_LIBC=y

# Explicitly disable userspace and syscalls to avoid conflicts
CONFIG_USERSPACE=n

# Memory management (increased for coverage when needed)
CONFIG_HEAP_MEM_POOL_SIZE=32768
CONFIG_MAIN_STACK_SIZE=8192

# Disable hardware-specific features for testing
CONFIG_BT=n
CONFIG_SENSOR=n
CONFIG_GPIO=n
CONFIG_I2C=n
CONFIG_SPI=n

# Disable power management
CONFIG_PM=n

# Enable coverage support for native simulation
CONFIG_COVERAGE=y
CONFIG_COVERAGE_NATIVE_GCOV=y
CONFIG_COVERAGE_DUMP=y

# Enable debug features for better coverage reporting
CONFIG_DEBUG=y
CONFIG_DEBUG_INFO=y
CONFIG_DEBUG_OPTIMIZATIONS=y

# Disable optimizations that interfere with coverage
CONFIG_NO_OPTIMIZATIONS=y

# Logging configuration for test debugging
CONFIG_LOG=y
CONFIG_LOG_MODE_IMMEDIATE=y
CONFIG_LOG_DEFAULT_LEVEL=3
```

## prj_coverage.conf
```kconfig
# Coverage-optimized test configuration
# This configuration maximizes coverage reporting accuracy

# ZTEST Framework - verbose for coverage correlation
CONFIG_ZTEST=y
CONFIG_ZTEST_VERBOSE_OUTPUT=y
CONFIG_ZTEST_STACK_SIZE=4096

# Use external (host) libc for native_sim
CONFIG_EXTERNAL_LIBC=y

# Explicitly disable userspace and syscalls to avoid conflicts
CONFIG_USERSPACE=n

# Memory management - increased for coverage data
CONFIG_HEAP_MEM_POOL_SIZE=32768
CONFIG_MAIN_STACK_SIZE=8192

# Disable hardware-specific features for testing
CONFIG_BT=n
CONFIG_SENSOR=n
CONFIG_GPIO=n
CONFIG_I2C=n
CONFIG_SPI=n

# Disable power management
CONFIG_PM=n

# Coverage configuration - comprehensive reporting
CONFIG_COVERAGE=y
CONFIG_COVERAGE_GCOV=y
CONFIG_COVERAGE_DUMP=y

# Debug configuration optimized for coverage
CONFIG_DEBUG=y
CONFIG_DEBUG_INFO=y
CONFIG_DEBUG_OPTIMIZATIONS=y

# Disable optimizations that interfere with coverage
CONFIG_NO_OPTIMIZATIONS=y
CONFIG_DEBUG_THREAD_INFO=y

# Enhanced logging for coverage correlation
CONFIG_LOG=y
CONFIG_LOG_MODE_IMMEDIATE=y
CONFIG_LOG_DEFAULT_LEVEL=4
CONFIG_LOG_PRINTK=y
CONFIG_LOG_BUFFER_SIZE=2048

# Console configuration for test output
CONFIG_CONSOLE=y
CONFIG_STDOUT_CONSOLE=y
CONFIG_PRINTK=y

# Timing configuration for deterministic tests
CONFIG_SYS_CLOCK_TICKS_PER_SEC=1000
```

## boards/native_sim.conf
```kconfig
#
# Copyright (c) 2024 Nordic Semiconductor ASA
#
# SPDX-License-Identifier: LicenseRef-Nordic-5-Clause
#

# Native simulation board configuration for testing
# Configuration specific to native_sim platform

# Use external (host) libc for compatibility
CONFIG_EXTERNAL_LIBC=y

# Memory optimizations for simulation
CONFIG_HEAP_MEM_POOL_SIZE=32768
CONFIG_MAIN_STACK_SIZE=16384

# Enable logging with native backend
CONFIG_LOG=y
CONFIG_LOG_BACKEND_NATIVE_POSIX=y
CONFIG_LOG_MODE_IMMEDIATE=y

# Enable assertions for thorough testing
CONFIG_ASSERT=y

# Enable console for test output
CONFIG_CONSOLE=y

# Disable power management for deterministic testing
CONFIG_PM=n
CONFIG_PM_DEVICE=n
```

## src/test_battery_service.c
```c
/*
 * Copyright (c) 2024 Nordic Semiconductor ASA
 *
 * SPDX-License-Identifier: LicenseRef-Nordic-5-Clause
 */

#include <zephyr/ztest.h>
#include <zephyr/logging/log.h>

LOG_MODULE_REGISTER(test_battery_service, CONFIG_LOG_DEFAULT_LEVEL);

/**
 * @brief Test suite for battery_service.c
 *
 * This file contains unit tests for the battery service module,
 * which monitors battery level and charging status.
 */

/* Test fixture setup */
static void *battery_service_setup(void)
{
	LOG_INF("Setting up battery service tests");
	return NULL;
}

static void battery_service_teardown(void *fixture)
{
	LOG_INF("Tearing down battery service tests");
}

ZTEST_SUITE(battery_service, NULL, battery_service_setup, NULL, NULL, battery_service_teardown);

/**
 * @brief Test battery service initialization
 */
ZTEST(battery_service, test_battery_service_init)
{
	LOG_INF("Testing battery service initialization");

	/* TODO: Add actual battery service initialization test */
	zassert_true(true, "Placeholder test");
}

/**
 * @brief Test battery level reading
 */
ZTEST(battery_service, test_battery_level_reading)
{
	LOG_INF("Testing battery level reading");

	/* TODO: Add actual battery level reading test */
	zassert_true(true, "Placeholder test");
}
```

## src/test_ess_service.c
```c
/*
 * Copyright (c) 2024 Nordic Semiconductor ASA
 *
 * SPDX-License-Identifier: LicenseRef-Nordic-5-Clause
 */

#include <zephyr/ztest.h>
#include <zephyr/logging/log.h>

LOG_MODULE_REGISTER(test_ess_service, CONFIG_LOG_DEFAULT_LEVEL);

/**
 * @brief Test suite for ess_service.c
 *
 * This file contains unit tests for the Environmental Sensing Service,
 * which provides BLE GATT characteristics for sensor data.
 */

/* Test fixture setup */
static void *ess_service_setup(void)
{
	LOG_INF("Setting up ESS service tests");
	return NULL;
}

static void ess_service_teardown(void *fixture)
{
	LOG_INF("Tearing down ESS service tests");
}

ZTEST_SUITE(ess_service, NULL, ess_service_setup, NULL, NULL, ess_service_teardown);

/**
 * @brief Test ESS service initialization
 */
ZTEST(ess_service, test_ess_service_init)
{
	LOG_INF("Testing ESS service initialization");

	/* TODO: Add actual ESS service initialization test */
	zassert_true(true, "Placeholder test");
}

/**
 * @brief Test ESS characteristic updates
 */
ZTEST(ess_service, test_ess_characteristic_updates)
{
	LOG_INF("Testing ESS characteristic updates");

	/* TODO: Add actual ESS characteristic update test */
	zassert_true(true, "Placeholder test");
}
```

## src/test_main.c
```c
/*
 * Copyright (c) 2024 Nordic Semiconductor ASA
 *
 * SPDX-License-Identifier: LicenseRef-Nordic-5-Clause
 */

#include <zephyr/ztest.h>
#include <string.h>

/**
 * @brief Main test entry point
 *
 * This file serves as the main entry point for all ZTEST-based unit tests
 * for the Nordic Thingy:52 Environmental Monitor project.
 *
 * This is a simplified test framework that validates the basic ZTEST
 * functionality without complex hardware mocking.
 */

static void *test_setup(void)
{
	printk("Starting Nordic Thingy:52 Environmental Monitor Test Suite\n");
	printk("ZTEST Framework initialized successfully\n");

	/* Global test setup - initialize any shared resources */
	return NULL;
}

static void test_teardown(void *fixture)
{
	printk("Test suite completed successfully\n");
	/* Global test cleanup */
}

/* Global test suite for framework validation */
ZTEST_SUITE(framework_validation, NULL, test_setup, NULL, NULL, test_teardown);

/**
 * @brief Basic framework validation test
 *
 * Ensures the ZTEST framework is working correctly and basic
 * assertions function as expected.
 */
ZTEST(framework_validation, test_framework_basic)
{
	printk("Running basic framework validation\n");

	/* Basic assertion tests */
	zassert_true(true, "Basic true assertion failed");
	zassert_false(false, "Basic false assertion failed");
	zassert_equal(1, 1, "Basic equality assertion failed");
	zassert_not_equal(1, 2, "Basic inequality assertion failed");
	zassert_is_null(NULL, "NULL pointer assertion failed");

	/* String comparison test */
	const char *test_str = "test";
	zassert_str_equal(test_str, "test", "String equality assertion failed");

	printk("Framework validation tests passed\n");
}

/**
 * @brief Test floating point support
 *
 * Validates that floating point operations work correctly in the test
 * environment, which is critical for sensor value calculations.
 */
ZTEST(framework_validation, test_floating_point_support)
{
	printk("Testing floating point support\n");

	float temp = 25.5f;
	float humidity = 60.2f;
	float pressure = 1013.25f;

	/* Test basic floating point operations */
	zassert_within(temp, 25.5f, 0.01f, "Temperature float comparison failed");
	zassert_within(humidity, 60.2f, 0.01f, "Humidity float comparison failed");
	zassert_within(pressure, 1013.25f, 0.01f, "Pressure float comparison failed");

	/* Test floating point arithmetic */
	float sum = temp + humidity;
	zassert_within(sum, 85.7f, 0.01f, "Float addition failed");

	printk("Floating point support validated\n");
}

/**
 * @brief Test memory allocation
 *
 * Ensures memory operations work in the test environment.
 */
ZTEST(framework_validation, test_memory_allocation)
{
	printk("Testing memory allocation\n");

	/* Test stack allocation */
	char stack_buffer[256];
	memset(stack_buffer, 0xAA, sizeof(stack_buffer));

	bool all_set = true;
	for (int i = 0; i < sizeof(stack_buffer); i++) {
		if (stack_buffer[i] != (char)0xAA) {
			all_set = false;
			break;
		}
	}

	zassert_true(all_set, "Stack buffer initialization failed");
	printk("Memory allocation tests passed\n");
}

/**
 * @brief Test suite for build system validation
 *
 * Validates that the build system is properly configured and
 * all necessary dependencies are available.
 */
ZTEST_SUITE(build_system_validation, NULL, NULL, NULL, NULL, NULL);

/**
 * @brief Test build configuration
 *
 * Ensures that important build-time configurations are set correctly.
 */
ZTEST(build_system_validation, test_build_configuration)
{
	printk("Testing build configuration\n");

	/* Verify ZTEST is enabled */
	zassert_true(IS_ENABLED(CONFIG_ZTEST), "CONFIG_ZTEST should be enabled");

	printk("Build configuration validated\n");
}

/**
 * @brief Test system functionality
 *
 * Basic system functionality tests to ensure the test environment
 * can support more complex testing in the future.
 */
ZTEST(build_system_validation, test_system_functionality)
{
	printk("Testing system functionality\n");

	/* Test simple arithmetic to ensure CPU is working */
	int a = 10;
	int b = 20;
	int result = a + b;
	zassert_equal(result, 30, "Basic arithmetic should work");

	printk("System functionality validated\n");
}
```

## src/test_main_simple.c
```c
/*
 * Copyright (c) 2024 Nordic Semiconductor ASA
 *
 * SPDX-License-Identifier: LicenseRef-Nordic-5-Clause
 */

#include <zephyr/ztest.h>
#include <zephyr/logging/log.h>
#include <string.h>

LOG_MODULE_REGISTER(test_main, CONFIG_LOG_DEFAULT_LEVEL);

/**
 * @file test_main_simple.c
 * @brief Simple test file to verify build and coverage setup
 *
 * This file contains basic tests to validate the test framework
 * and coverage reporting setup works correctly.
 */

/**
 * @brief Test suite for framework validation - simple version
 */
ZTEST_SUITE(framework_validation, NULL, NULL, NULL, NULL, NULL);

/**
 * @brief Basic framework test
 */
ZTEST(framework_validation, test_basic_functionality)
{
    LOG_INF("TEST: Basic framework functionality");
    
    /* Basic assertions */
    zassert_true(true, "Basic true assertion must pass");
    zassert_false(false, "Basic false assertion must pass");
    zassert_equal(1, 1, "Integer equality must pass");
    zassert_not_equal(1, 2, "Integer inequality must pass");
    
    /* String comparison */
    zassert_str_equal("test", "test", "String equality must pass");
    
    LOG_INF("PASS: Basic framework test completed");
}

/**
 * @brief Floating point test
 */
ZTEST(framework_validation, test_floating_point)
{
    LOG_INF("TEST: Floating point operations");
    
    float temp = 25.5f;
    float tolerance = 0.01f;
    
    zassert_within(temp, 25.5f, tolerance, "Float comparison must work");
    
    /* Test arithmetic */
    float sum = temp + 10.0f;
    zassert_within(sum, 35.5f, tolerance, "Float arithmetic must work");
    
    LOG_INF("PASS: Floating point test completed");
}

/**
 * @brief Memory operations test
 */
ZTEST(framework_validation, test_memory_operations)
{
    LOG_INF("TEST: Memory operations");
    
    /* Stack buffer test */
    uint8_t buffer[64];
    memset(buffer, 0xAA, sizeof(buffer));
    
    /* Verify pattern */
    for (size_t i = 0; i < sizeof(buffer); i++) {
        zassert_equal(buffer[i], 0xAA, "Buffer pattern must be correct");
    }
    
    LOG_INF("PASS: Memory operations test completed");
}

/**
 * @brief Build system validation
 */
ZTEST_SUITE(build_validation, NULL, NULL, NULL, NULL, NULL);

/**
 * @brief Test build configuration
 */
ZTEST(build_validation, test_build_config)
{
    LOG_INF("TEST: Build configuration");
    
    /* Verify ZTEST is enabled */
    zassert_true(IS_ENABLED(CONFIG_ZTEST), "ZTEST must be enabled");
    
    #ifdef CONFIG_COVERAGE
    LOG_INF("Coverage reporting enabled");
    #endif
    
    LOG_INF("PASS: Build configuration test completed");
}

/**
 * @brief Test system functionality
 */
ZTEST(build_validation, test_system_functions)
{
    LOG_INF("TEST: System functionality");
    
    /* Basic arithmetic */
    int a = 10, b = 20;
    int result = a + b;
    zassert_equal(result, 30, "Arithmetic must work");
    
    /* String operations */
    int len = strlen("test");
    zassert_equal(len, 4, "String functions must work");
    
    LOG_INF("PASS: System functionality test completed");
}
```

## src/test_mock_framework.c
```c
/*
 * Copyright (c) 2024 Nordic Semiconductor ASA
 *
 * SPDX-License-Identifier: LicenseRef-Nordic-5-Clause
 */

#include <zephyr/ztest.h>
#include <zephyr/logging/log.h>
#include "mock_i2c.h"
#include "mock_gpio.h"
#include "mock_sensor.h"

LOG_MODULE_REGISTER(test_mocks, CONFIG_LOG_DEFAULT_LEVEL);

/**
 * @brief Test suite for mock framework validation
 *
 * This file contains tests to validate that the mock framework
 * implementations work correctly before testing actual modules.
 */

/* Test fixture setup */
static void *mock_tests_setup(void)
{
	LOG_INF("Setting up mock framework tests");

	/* Initialize all mock systems */
	mock_i2c_init();
	mock_gpio_init();
	mock_sensor_init();

	return NULL;
}

static void mock_tests_before_each(void *fixture)
{
	/* Reset all mock states before each test */
	mock_i2c_reset();
	mock_gpio_reset();
	mock_sensor_reset();
}

static void mock_tests_teardown(void *fixture)
{
	LOG_INF("Tearing down mock framework tests");
}

ZTEST_SUITE(mock_framework, NULL, mock_tests_setup, mock_tests_before_each, NULL,
	    mock_tests_teardown);

/**
 * @brief Test I2C mock basic functionality
 */
ZTEST(mock_framework, test_i2c_mock_basic)
{
	LOG_INF("Testing I2C mock basic functionality");

	/* Create a mock device */
	struct device mock_i2c_dev = {0};

	/* Set up expected I2C transaction */
	uint8_t write_data[] = {0x20, 0x01};
	uint8_t read_data[] = {0x81};
	uint8_t read_buffer[1];

	struct mock_i2c_transaction expected = {.type = MOCK_I2C_WRITE_READ,
						.addr = 0x3E,
						.write_buf = write_data,
						.write_len = sizeof(write_data),
						.read_buf = read_data, /* Expected data to return */
						.read_len = sizeof(read_data),
						.expected_return = 0};

	mock_i2c_expect_transaction(&expected);

	/* Simulate I2C operation that would be called by sensor driver */
	int ret = i2c_write_read_mock(&mock_i2c_dev, 0x3E, write_data, sizeof(write_data),
				      read_buffer, sizeof(read_buffer));

	/* Verify results */
	zassert_ok(ret, "I2C write_read should succeed");
	zassert_mem_equal(read_buffer, read_data, sizeof(read_data),
			  "Read data should match expected");

	/* Verify all expected transactions were processed */
	mock_i2c_verify_complete();

	LOG_INF("I2C mock test passed");
}

/**
 * @brief Test GPIO mock basic functionality
 */
ZTEST(mock_framework, test_gpio_mock_basic)
{
	LOG_INF("Testing GPIO mock basic functionality");

	/* Create a mock device */
	struct device mock_gpio_dev = {0};

	/* Test GPIO pin configuration */
	int ret = gpio_pin_configure_mock(&mock_gpio_dev, 10, GPIO_OUTPUT_ACTIVE);
	zassert_ok(ret, "GPIO pin configure should succeed");

	/* Test GPIO pin set */
	ret = gpio_pin_set_mock(&mock_gpio_dev, 10, 1);
	zassert_ok(ret, "GPIO pin set should succeed");

	/* Test GPIO pin get */
	int value = gpio_pin_get_mock(&mock_gpio_dev, 10);
	zassert_equal(value, 1, "GPIO pin value should be 1");

	/* Test GPIO pin toggle */
	ret = gpio_pin_toggle_mock(&mock_gpio_dev, 10);
	zassert_ok(ret, "GPIO pin toggle should succeed");

	value = gpio_pin_get_mock(&mock_gpio_dev, 10);
	zassert_equal(value, 0, "GPIO pin value should be 0 after toggle");

	/* Verify pin configuration */
	mock_gpio_verify_pin_config(&mock_gpio_dev, 10, GPIO_OUTPUT_ACTIVE);

	LOG_INF("GPIO mock test passed");
}

/**
 * @brief Test sensor mock basic functionality
 */
ZTEST(mock_framework, test_sensor_mock_basic)
{
	LOG_INF("Testing sensor mock basic functionality");

	/* Create a mock device */
	struct device mock_sensor_dev = {0};

	/* Set up expected sensor reading */
	struct sensor_value temp_reading;
	sensor_value_from_float(&temp_reading, 25.5f);

	mock_sensor_set_reading(&mock_sensor_dev, SENSOR_CHAN_AMBIENT_TEMP, &temp_reading);

	/* Test sensor sample fetch */
	int ret = sensor_sample_fetch_mock(&mock_sensor_dev);
	zassert_ok(ret, "Sensor sample fetch should succeed");

	/* Test sensor channel get */
	struct sensor_value retrieved_value;
	ret = sensor_channel_get_mock(&mock_sensor_dev, SENSOR_CHAN_AMBIENT_TEMP, &retrieved_value);
	zassert_ok(ret, "Sensor channel get should succeed");

	/* Verify the value */
	float retrieved_float = sensor_value_to_float(&retrieved_value);
	zassert_within(retrieved_float, 25.5f, 0.01f, "Temperature reading should match");

	/* Test call counting */
	zassert_equal(mock_sensor_get_fetch_call_count(&mock_sensor_dev), 1,
		      "Fetch should have been called once");
	zassert_equal(mock_sensor_get_get_call_count(&mock_sensor_dev), 1,
		      "Get should have been called once");

	LOG_INF("Sensor mock test passed");
}

/**
 * @brief Test mock error conditions
 */
ZTEST(mock_framework, test_mock_error_conditions)
{
	LOG_INF("Testing mock error conditions");

	/* Create mock devices */
	struct device mock_i2c_dev = {0};
	struct device mock_gpio_dev = {0};
	struct device mock_sensor_dev = {0};

	/* Test I2C device not ready */
	mock_i2c_set_device_ready(&mock_i2c_dev, false);
	uint8_t dummy_data[] = {0x00};
	int ret = i2c_write_mock(&mock_i2c_dev, dummy_data, sizeof(dummy_data), 0x3E);
	zassert_equal(ret, -ENODEV, "I2C should return ENODEV when device not ready");

	/* Reset I2C device to ready for further tests */
	mock_i2c_set_device_ready(&mock_i2c_dev, true);

	/* Test GPIO device not ready */
	mock_gpio_set_device_ready(&mock_gpio_dev, false);
	ret = gpio_pin_configure_mock(&mock_gpio_dev, 0, GPIO_OUTPUT);
	zassert_equal(ret, -ENODEV, "GPIO should return ENODEV when device not ready");

	/* Reset GPIO device to ready for further tests */
	mock_gpio_set_device_ready(&mock_gpio_dev, true);

	/* Test sensor device not ready */
	mock_sensor_set_device_ready(&mock_sensor_dev, false);
	ret = sensor_sample_fetch_mock(&mock_sensor_dev);
	zassert_equal(ret, -ENODEV, "Sensor should return ENODEV when device not ready");

	/* Test sensor fetch failure */
	mock_sensor_set_device_ready(&mock_sensor_dev, true);
	mock_sensor_set_fetch_result(&mock_sensor_dev, false);
	ret = sensor_sample_fetch_mock(&mock_sensor_dev);
	zassert_equal(ret, -EIO, "Sensor should return EIO when fetch fails");

	LOG_INF("Mock error condition tests passed");
}

/**
 * @brief Test complex mock interaction scenarios
 */
ZTEST(mock_framework, test_mock_complex_scenarios)
{
	LOG_INF("Testing complex mock interaction scenarios");

	/* Scenario: CCS811 sensor initialization sequence */
	struct device mock_i2c_dev = {0};
	struct device mock_gpio_dev = {0};

	/* Step 1: GPIO power on (SX1509B pin 10) */
	int ret = gpio_pin_set_mock(&mock_gpio_dev, 10, 1);
	zassert_ok(ret, "GPIO power pin set should succeed");

	/* Step 2: GPIO reset release (SX1509B pin 11) */
	ret = gpio_pin_set_mock(&mock_gpio_dev, 11, 1);
	zassert_ok(ret, "GPIO reset pin set should succeed");

	/* Step 3: I2C Hardware ID read */
	uint8_t hw_id_reg = 0x20;
	uint8_t expected_hw_id = 0x81;
	uint8_t hw_id_buffer[1];

	struct mock_i2c_transaction hw_id_read = {.type = MOCK_I2C_WRITE_READ,
						  .addr = 0x5A,
						  .write_buf = &hw_id_reg,
						  .write_len = 1,
						  .read_buf = &expected_hw_id,
						  .read_len = 1,
						  .expected_return = 0};

	mock_i2c_expect_transaction(&hw_id_read);

	ret = i2c_write_read_mock(&mock_i2c_dev, 0x5A, &hw_id_reg, 1, hw_id_buffer, 1);
	zassert_ok(ret, "I2C hardware ID read should succeed");
	zassert_equal(hw_id_buffer[0], 0x81, "Hardware ID should be 0x81");

	/* Verify all mock interactions */
	mock_i2c_verify_complete();

	/* Verify GPIO states */
	int power_state = mock_gpio_get_pin_value(&mock_gpio_dev, 10);
	int reset_state = mock_gpio_get_pin_value(&mock_gpio_dev, 11);

	zassert_equal(power_state, 1, "Power pin should be high");
	zassert_equal(reset_state, 1, "Reset pin should be high");

	LOG_INF("Complex mock scenario test passed");
}
```

## src/test_sensor_manager.c
```c
/*
 * Copyright (c) 2024 Nordic Semiconductor ASA
 *
 * SPDX-License-Identifier: LicenseRef-Nordic-5-Clause
 */

#include <zephyr/ztest.h>
#include <zephyr/logging/log.h>
#include "mock_i2c.h"
#include "mock_gpio.h"
#include "mock_sensor.h"

LOG_MODULE_REGISTER(test_sensor_manager, CONFIG_LOG_DEFAULT_LEVEL);

/**
 * @brief Test suite for sensor_manager.c
 *
 * This file contains unit tests for the sensor manager module,
 * which coordinates environmental sensor readings and power management.
 *
 * Note: These are demonstration tests showing the framework structure.
 * Full implementation would require integrating with actual sensor_manager.c
 */

/* Mock device instances (would normally come from device tree) */
static struct device mock_i2c_device = {.name = "I2C_0"};
static struct device mock_hts221_device = {.name = "HTS221"};
static struct device mock_lps22hb_device = {.name = "LPS22HB"};
static struct device mock_ccs811_device = {.name = "CCS811"};
static struct device mock_sx1509b_device = {.name = "SX1509B"};

/* Test fixture setup */
static void *sensor_manager_setup(void)
{
	LOG_INF("Setting up sensor manager tests");

	/* Initialize all mock systems */
	mock_i2c_init();
	mock_gpio_init();
	mock_sensor_init();

	return NULL;
}

static void sensor_manager_before_each(void *fixture)
{
	/* Reset all mock states before each test */
	mock_i2c_reset();
	mock_gpio_reset();
	mock_sensor_reset();

	/* Set up default device ready states */
	mock_i2c_set_device_ready(&mock_i2c_device, true);
	mock_sensor_set_device_ready(&mock_hts221_device, true);
	mock_sensor_set_device_ready(&mock_lps22hb_device, true);
	mock_sensor_set_device_ready(&mock_ccs811_device, true);
	mock_gpio_set_device_ready(&mock_sx1509b_device, true);
}

static void sensor_manager_teardown(void *fixture)
{
	LOG_INF("Tearing down sensor manager tests");
}

ZTEST_SUITE(sensor_manager, NULL, sensor_manager_setup, sensor_manager_before_each, NULL,
	    sensor_manager_teardown);

/**
 * @brief Test sensor manager initialization workflow
 *
 * This test demonstrates how the sensor manager would initialize
 * all connected sensors and verify their hardware IDs.
 */
ZTEST(sensor_manager, test_sensor_manager_init_workflow)
{
	LOG_INF("Testing sensor manager initialization workflow");

	/* Test 1: HTS221 initialization */
	/* Set up expected HTS221 hardware ID read (0x0F register should return 0xBC) */
	uint8_t hts221_who_am_i_reg = 0x0F;
	uint8_t hts221_expected_id = 0xBC;
	uint8_t hts221_id_buffer[1];

	struct mock_i2c_transaction hts221_id_read = {.type = MOCK_I2C_WRITE_READ,
						      .addr = 0x5F, /* HTS221 I2C address */
						      .write_buf = &hts221_who_am_i_reg,
						      .write_len = 1,
						      .read_buf = &hts221_expected_id,
						      .read_len = 1,
						      .expected_return = 0};

	mock_i2c_expect_transaction(&hts221_id_read);

	/* Simulate HTS221 ID read */
	int ret = i2c_write_read_mock(&mock_i2c_device, 0x5F, &hts221_who_am_i_reg, 1,
				      hts221_id_buffer, 1);
	zassert_ok(ret, "HTS221 ID read should succeed");
	zassert_equal(hts221_id_buffer[0], 0xBC, "HTS221 ID should be 0xBC");

	/* Test 2: LPS22HB initialization */
	uint8_t lps22hb_who_am_i_reg = 0x0F;
	uint8_t lps22hb_expected_id = 0xB1;
	uint8_t lps22hb_id_buffer[1];

	struct mock_i2c_transaction lps22hb_id_read = {.type = MOCK_I2C_WRITE_READ,
						       .addr = 0x5C, /* LPS22HB I2C address */
						       .write_buf = &lps22hb_who_am_i_reg,
						       .write_len = 1,
						       .read_buf = &lps22hb_expected_id,
						       .read_len = 1,
						       .expected_return = 0};

	mock_i2c_expect_transaction(&lps22hb_id_read);

	ret = i2c_write_read_mock(&mock_i2c_device, 0x5C, &lps22hb_who_am_i_reg, 1,
				  lps22hb_id_buffer, 1);
	zassert_ok(ret, "LPS22HB ID read should succeed");
	zassert_equal(lps22hb_id_buffer[0], 0xB1, "LPS22HB ID should be 0xB1");

	/* Test 3: CCS811 initialization with SX1509B power control */
	/* First, enable CCS811 power via SX1509B pin 10 */
	ret = gpio_pin_set_mock(&mock_sx1509b_device, 10, 1);
	zassert_ok(ret, "CCS811 power enable should succeed");

	/* Release CCS811 reset via SX1509B pin 11 */
	ret = gpio_pin_set_mock(&mock_sx1509b_device, 11, 1);
	zassert_ok(ret, "CCS811 reset release should succeed");

	/* Read CCS811 hardware ID */
	uint8_t ccs811_hw_id_reg = 0x20;
	uint8_t ccs811_expected_id = 0x81;
	uint8_t ccs811_id_buffer[1];

	struct mock_i2c_transaction ccs811_id_read = {.type = MOCK_I2C_WRITE_READ,
						      .addr = 0x5A, /* CCS811 I2C address */
						      .write_buf = &ccs811_hw_id_reg,
						      .write_len = 1,
						      .read_buf = &ccs811_expected_id,
						      .read_len = 1,
						      .expected_return = 0};

	mock_i2c_expect_transaction(&ccs811_id_read);

	ret = i2c_write_read_mock(&mock_i2c_device, 0x5A, &ccs811_hw_id_reg, 1, ccs811_id_buffer,
				  1);
	zassert_ok(ret, "CCS811 ID read should succeed");
	zassert_equal(ccs811_id_buffer[0], 0x81, "CCS811 ID should be 0x81");

	/* Verify all expected I2C transactions completed */
	mock_i2c_verify_complete();

	/* Verify GPIO pin states */
	int ccs811_power = mock_gpio_get_pin_value(&mock_sx1509b_device, 10);
	int ccs811_reset = mock_gpio_get_pin_value(&mock_sx1509b_device, 11);

	zassert_equal(ccs811_power, 1, "CCS811 power should be enabled");
	zassert_equal(ccs811_reset, 1, "CCS811 reset should be released");

	LOG_INF("Sensor manager initialization workflow test passed");
}

/**
 * @brief Test sensor data reading workflow
 *
 * This test demonstrates how the sensor manager would read
 * environmental data from all sensors.
 */
ZTEST(sensor_manager, test_sensor_data_reading_workflow)
{
	LOG_INF("Testing sensor data reading workflow");

	/* Set up expected sensor readings */
	struct sensor_value temp_reading, humidity_reading, pressure_reading;

	sensor_value_from_float(&temp_reading, 25.5f);        /* 25.5°C */
	sensor_value_from_float(&humidity_reading, 60.2f);    /* 60.2% RH */
	sensor_value_from_float(&pressure_reading, 1013.25f); /* 1013.25 hPa */

	/* Configure mock sensor readings */
	mock_sensor_set_reading(&mock_hts221_device, SENSOR_CHAN_AMBIENT_TEMP, &temp_reading);
	mock_sensor_set_reading(&mock_hts221_device, SENSOR_CHAN_HUMIDITY, &humidity_reading);
	mock_sensor_set_reading(&mock_lps22hb_device, SENSOR_CHAN_PRESS, &pressure_reading);

	/* Test HTS221 temperature and humidity reading */
	int ret = sensor_sample_fetch_mock(&mock_hts221_device);
	zassert_ok(ret, "HTS221 sample fetch should succeed");

	struct sensor_value retrieved_temp, retrieved_humidity;
	ret = sensor_channel_get_mock(&mock_hts221_device, SENSOR_CHAN_AMBIENT_TEMP,
				      &retrieved_temp);
	zassert_ok(ret, "HTS221 temperature get should succeed");

	ret = sensor_channel_get_mock(&mock_hts221_device, SENSOR_CHAN_HUMIDITY,
				      &retrieved_humidity);
	zassert_ok(ret, "HTS221 humidity get should succeed");

	/* Verify readings */
	float temp_float = sensor_value_to_float(&retrieved_temp);
	float humidity_float = sensor_value_to_float(&retrieved_humidity);

	zassert_within(temp_float, 25.5f, 0.01f, "Temperature should be 25.5°C");
	zassert_within(humidity_float, 60.2f, 0.01f, "Humidity should be 60.2%%");

	/* Test LPS22HB pressure reading */
	ret = sensor_sample_fetch_mock(&mock_lps22hb_device);
	zassert_ok(ret, "LPS22HB sample fetch should succeed");

	struct sensor_value retrieved_pressure;
	ret = sensor_channel_get_mock(&mock_lps22hb_device, SENSOR_CHAN_PRESS, &retrieved_pressure);
	zassert_ok(ret, "LPS22HB pressure get should succeed");

	float pressure_float = sensor_value_to_float(&retrieved_pressure);
	zassert_within(pressure_float, 1013.25f, 0.01f, "Pressure should be 1013.25 hPa");

	/* Verify call counts */
	zassert_equal(mock_sensor_get_fetch_call_count(&mock_hts221_device), 1,
		      "HTS221 fetch should be called once");
	zassert_equal(mock_sensor_get_get_call_count(&mock_hts221_device), 2,
		      "HTS221 get should be called twice (temp + humidity)");
	zassert_equal(mock_sensor_get_fetch_call_count(&mock_lps22hb_device), 1,
		      "LPS22HB fetch should be called once");
	zassert_equal(mock_sensor_get_get_call_count(&mock_lps22hb_device), 1,
		      "LPS22HB get should be called once");

	LOG_INF("Sensor data reading workflow test passed");
}

/**
 * @brief Test sensor error handling
 *
 * This test verifies that the sensor manager properly handles
 * sensor failures and error conditions.
 */
ZTEST(sensor_manager, test_sensor_error_handling)
{
	LOG_INF("Testing sensor error handling");

	/* Test 1: Sensor device not ready */
	mock_sensor_set_device_ready(&mock_hts221_device, false);

	int ret = sensor_sample_fetch_mock(&mock_hts221_device);
	zassert_equal(ret, -ENODEV, "Should return ENODEV when device not ready");

	/* Test 2: Sensor fetch failure */
	mock_sensor_set_device_ready(&mock_hts221_device, true);
	mock_sensor_set_fetch_result(&mock_hts221_device, false);

	ret = sensor_sample_fetch_mock(&mock_hts221_device);
	zassert_equal(ret, -EIO, "Should return EIO when fetch fails");

	/* Test 3: I2C communication failure */
	uint8_t dummy_buffer[1];

	/* Set I2C device not ready */
	mock_i2c_set_device_ready(&mock_i2c_device, false);

	ret = i2c_read_mock(&mock_i2c_device, dummy_buffer, 1, 0x5F);
	zassert_equal(ret, -ENODEV, "Should return ENODEV when I2C device not ready");

	/* Reset I2C device to ready state for cleanup */
	mock_i2c_set_device_ready(&mock_i2c_device, true);

	/* Test 4: GPIO failure (SX1509B not ready) */
	mock_gpio_set_device_ready(&mock_sx1509b_device, false);

	ret = gpio_pin_set_mock(&mock_sx1509b_device, 10, 1);
	zassert_equal(ret, -ENODEV, "Should return ENODEV when GPIO device not ready");

	/* Reset GPIO device to ready state for cleanup */
	mock_gpio_set_device_ready(&mock_sx1509b_device, true);

	LOG_INF("Sensor error handling test passed");
}
```

## src/test_sensor_manager_policy.c
```c
/*
 * Copyright (c) 2024 Nordic Semiconductor ASA
 *
 * SPDX-License-Identifier: LicenseRef-Nordic-5-Clause
 */

#include <zephyr/ztest.h>
#include <zephyr/logging/log.h>
#include "sensor_manager.h"

LOG_MODULE_REGISTER(test_sensor_manager_policy, CONFIG_LOG_DEFAULT_LEVEL);

#define TEST_AQ_DIVISOR_TWO 2U

#ifdef CONFIG_SENSOR_ENV_INTERVAL_SEC
#define TEST_SAMPLING_INTERVAL_SEC CONFIG_SENSOR_ENV_INTERVAL_SEC
#else
#define TEST_SAMPLING_INTERVAL_SEC 900U
#endif

/* CCS811 validation constants — must match sensor_manager.c definitions */
#define TEST_CCS811_INVALID_READING 65021U /* 0xFE0D */
#define TEST_CCS811_ECO2_MIN_PPM    400U
#define TEST_CCS811_ECO2_MAX_PPM    8192U
#define TEST_CCS811_TVOC_MIN_PPB    0U
#define TEST_CCS811_TVOC_MAX_PPB    1187U

/* -------------------------------------------------------------------------
 * Helpers
 * -----------------------------------------------------------------------*/

/**
 * Replicates the AQ divisor decision from sensor_work_handler.
 * Returns true when the cycle should include an air-quality read.
 */
static inline bool should_read_aq(uint32_t cycle, uint32_t divisor)
{
	return (cycle % divisor) == 0;
}

/**
 * Replicates the eCO2 validation logic from sensor_manager.c.
 * Returns true when the reading is within the accepted hardware range.
 */
static inline bool eco2_reading_valid(uint16_t eco2)
{
	return eco2 != TEST_CCS811_INVALID_READING && eco2 != 0U &&
	       eco2 >= TEST_CCS811_ECO2_MIN_PPM && eco2 <= TEST_CCS811_ECO2_MAX_PPM;
}

/**
 * Replicates the TVOC validation logic from sensor_manager.c.
 * Returns true when the reading is within the accepted hardware range.
 */
static inline bool tvoc_reading_valid(uint16_t tvoc)
{
	return tvoc != TEST_CCS811_INVALID_READING && tvoc >= TEST_CCS811_TVOC_MIN_PPB &&
	       tvoc <= TEST_CCS811_TVOC_MAX_PPB;
}

/* -------------------------------------------------------------------------
 * ZTEST Suite: sensor_manager_aq_divisor
 * Tests AQ sub-sampling policy in periodic sampling.
 * sensor_work_handler increments aq_cycle before each periodic update and
 * only includes SENSOR_AIR_QUALITY when (aq_cycle % divisor == 0).
 * -----------------------------------------------------------------------*/

ZTEST_SUITE(sensor_manager_aq_divisor, NULL, NULL, NULL, NULL, NULL);

ZTEST(sensor_manager_aq_divisor, test_first_cycle_skips_aq)
{
	/* Cycle 1 (first scheduled read): odd → AQ should be skipped */
	zassert_false(should_read_aq(1, TEST_AQ_DIVISOR_TWO),
		      "Cycle 1 must NOT read AQ (divisor=%u)", TEST_AQ_DIVISOR_TWO);
}

ZTEST(sensor_manager_aq_divisor, test_second_cycle_reads_aq)
{
	/* Cycle 2: even → AQ should be included */
	zassert_true(should_read_aq(2, TEST_AQ_DIVISOR_TWO), "Cycle 2 must read AQ (divisor=%u)",
		     TEST_AQ_DIVISOR_TWO);
}

ZTEST(sensor_manager_aq_divisor, test_odd_cycles_skip_aq)
{
	/* All odd cycles should skip AQ */
	for (uint32_t cycle = 1; cycle <= 9; cycle += 2) {
		zassert_false(should_read_aq(cycle, TEST_AQ_DIVISOR_TWO),
			      "Odd cycle %u must NOT read AQ", cycle);
	}
}

ZTEST(sensor_manager_aq_divisor, test_even_cycles_read_aq)
{
	/* All even cycles should include AQ */
	for (uint32_t cycle = 2; cycle <= 10; cycle += 2) {
		zassert_true(should_read_aq(cycle, TEST_AQ_DIVISOR_TWO),
			     "Even cycle %u must read AQ", cycle);
	}
}

ZTEST(sensor_manager_aq_divisor, test_flags_with_aq)
{
	/* When AQ is included, the full sensor flag set must contain SENSOR_AIR_QUALITY */
	uint32_t full_flags = SENSOR_TEMPERATURE | SENSOR_HUMIDITY | SENSOR_PRESSURE |
			      SENSOR_BATTERY | SENSOR_AIR_QUALITY;

	zassert_not_equal(full_flags & SENSOR_AIR_QUALITY, 0U,
			  "Full flag set must include SENSOR_AIR_QUALITY");
}

ZTEST(sensor_manager_aq_divisor, test_flags_without_aq)
{
	/* When AQ is skipped, the flag set must NOT contain SENSOR_AIR_QUALITY */
	uint32_t skip_aq_flags =
		SENSOR_TEMPERATURE | SENSOR_HUMIDITY | SENSOR_PRESSURE | SENSOR_BATTERY;

	zassert_equal(skip_aq_flags & SENSOR_AIR_QUALITY, 0U,
		      "Skip-AQ flag set must NOT include SENSOR_AIR_QUALITY");
}

ZTEST(sensor_manager_aq_divisor, test_divisor_one_always_reads_aq)
{
	/* With divisor=1, every cycle should read AQ */
	for (uint32_t cycle = 1; cycle <= 5; cycle++) {
		zassert_true(should_read_aq(cycle, 1),
			     "With divisor=1, cycle %u must always read AQ", cycle);
	}
}

/* -------------------------------------------------------------------------
 * ZTEST Suite: sensor_manager_ccs811_validation
 * Tests CCS811 reading validation logic.
 * sensor_manager.c filters out-of-range and sentinel-value readings.
 * -----------------------------------------------------------------------*/

ZTEST_SUITE(sensor_manager_ccs811_validation, NULL, NULL, NULL, NULL, NULL);

ZTEST(sensor_manager_ccs811_validation, test_eco2_valid_range)
{
	/* Minimum valid eCO2: 400 ppm (atmospheric CO2 baseline) */
	zassert_true(eco2_reading_valid(TEST_CCS811_ECO2_MIN_PPM),
		     "Minimum eCO2 %u ppm must be valid", TEST_CCS811_ECO2_MIN_PPM);

	/* Mid-range reading */
	zassert_true(eco2_reading_valid(1000U), "Mid-range eCO2 1000 ppm must be valid");

	/* Maximum valid eCO2 per CCS811 spec */
	zassert_true(eco2_reading_valid(TEST_CCS811_ECO2_MAX_PPM),
		     "Maximum eCO2 %u ppm must be valid", TEST_CCS811_ECO2_MAX_PPM);
}

ZTEST(sensor_manager_ccs811_validation, test_eco2_invalid_sentinel)
{
	/* 0xFE0D is the hardware sentinel for "not ready" */
	zassert_false(eco2_reading_valid(TEST_CCS811_INVALID_READING),
		      "Sentinel 0x%04X must be invalid", TEST_CCS811_INVALID_READING);
}

ZTEST(sensor_manager_ccs811_validation, test_eco2_invalid_zero)
{
	/* Zero is not a valid eCO2 reading */
	zassert_false(eco2_reading_valid(0U), "Zero eCO2 must be invalid");
}

ZTEST(sensor_manager_ccs811_validation, test_eco2_below_minimum)
{
	/* Below atmospheric baseline is not a valid reading */
	zassert_false(eco2_reading_valid(TEST_CCS811_ECO2_MIN_PPM - 1U),
		      "eCO2 below minimum (%u ppm) must be invalid", TEST_CCS811_ECO2_MIN_PPM - 1U);
}

ZTEST(sensor_manager_ccs811_validation, test_eco2_above_maximum)
{
	/* Above hardware maximum is not a valid reading */
	zassert_false(eco2_reading_valid(TEST_CCS811_ECO2_MAX_PPM + 1U),
		      "eCO2 above maximum (%u ppm) must be invalid", TEST_CCS811_ECO2_MAX_PPM + 1U);
}

ZTEST(sensor_manager_ccs811_validation, test_tvoc_valid_range)
{
	/* Zero TVOC is valid (clean air) */
	zassert_true(tvoc_reading_valid(TEST_CCS811_TVOC_MIN_PPB),
		     "TVOC 0 ppb must be valid (clean air baseline)");

	/* Mid-range TVOC */
	zassert_true(tvoc_reading_valid(500U), "TVOC 500 ppb must be valid");

	/* Maximum valid TVOC per CCS811 spec */
	zassert_true(tvoc_reading_valid(TEST_CCS811_TVOC_MAX_PPB),
		     "Maximum TVOC %u ppb must be valid", TEST_CCS811_TVOC_MAX_PPB);
}

ZTEST(sensor_manager_ccs811_validation, test_tvoc_invalid_sentinel)
{
	zassert_false(tvoc_reading_valid(TEST_CCS811_INVALID_READING),
		      "Sentinel 0x%04X must be invalid for TVOC", TEST_CCS811_INVALID_READING);
}

ZTEST(sensor_manager_ccs811_validation, test_tvoc_above_maximum)
{
	zassert_false(tvoc_reading_valid(TEST_CCS811_TVOC_MAX_PPB + 1U),
		      "TVOC above maximum (%u ppb) must be invalid", TEST_CCS811_TVOC_MAX_PPB + 1U);
}

/* -------------------------------------------------------------------------
 * ZTEST Suite: sensor_manager_sensor_data
 * Tests the sensor_data structure contract.
 * Zero-initialised structs must have all validity flags false.
 * -----------------------------------------------------------------------*/

ZTEST_SUITE(sensor_manager_sensor_data, NULL, NULL, NULL, NULL, NULL);

ZTEST(sensor_manager_sensor_data, test_zero_init_all_invalid)
{
	struct sensor_data d = {0};

	zassert_false(SENSOR_DATA_IS_VALID(&d, SENSOR_TEMPERATURE),
		      "Zero-init SENSOR_TEMPERATURE must be invalid");
	zassert_false(SENSOR_DATA_IS_VALID(&d, SENSOR_HUMIDITY),
		      "Zero-init SENSOR_HUMIDITY must be invalid");
	zassert_false(SENSOR_DATA_IS_VALID(&d, SENSOR_PRESSURE),
		      "Zero-init SENSOR_PRESSURE must be invalid");
	zassert_false(SENSOR_DATA_IS_VALID(&d, SENSOR_AIR_QUALITY),
		      "Zero-init SENSOR_AIR_QUALITY must be invalid");
	zassert_false(SENSOR_DATA_IS_VALID(&d, SENSOR_BATTERY),
		      "Zero-init SENSOR_BATTERY must be invalid");
}

ZTEST(sensor_manager_sensor_data, test_validity_flags_set_independently)
{
	struct sensor_data d = {0};

	d.temperature = 22.5f;
	d.valid_mask |= SENSOR_TEMPERATURE;

	zassert_true(SENSOR_DATA_IS_VALID(&d, SENSOR_TEMPERATURE),
		     "SENSOR_TEMPERATURE should be valid after set");
	zassert_false(SENSOR_DATA_IS_VALID(&d, SENSOR_HUMIDITY),
		      "SENSOR_HUMIDITY must remain invalid");
	zassert_false(SENSOR_DATA_IS_VALID(&d, SENSOR_PRESSURE),
		      "SENSOR_PRESSURE must remain invalid");
	zassert_false(SENSOR_DATA_IS_VALID(&d, SENSOR_AIR_QUALITY),
		      "SENSOR_AIR_QUALITY must remain invalid");
}

ZTEST(sensor_manager_sensor_data, test_sampling_interval_is_900s)
{
	/* Guard against accidental reduction of the periodic sampling interval. */
	zassert_equal(TEST_SAMPLING_INTERVAL_SEC, 900U,
		      "Sampling interval must be 900 s (15 min) for battery life target");
}
```
