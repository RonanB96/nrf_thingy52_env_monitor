## app/tests/hardware/testcase.yaml
```yaml
common:
  tags:
    - hil
    - sensors

tests:
  thingy52.env_monitor.hil.sensors:
    platform_allow:
      - thingy52/nrf52832
    integration_platforms:
      - thingy52/nrf52832
    harness: ztest
    timeout: 120
    tags:
      - hil
      - sensors
      - hts221
      - lps22hb
      - ccs811
```

## app/tests/integration/full_app/testcase.yaml
```yaml
common:
  tags:
    - integration
    - sensor_wrappers
    - coverage

tests:
  thingy52.env_monitor.integration.full_app:
    platform_allow:
      - native_sim
      - native_sim/native/64
    integration_platforms:
      - native_sim
    harness: ztest
```

## app/tests/testcase.yaml
```yaml
common:
  tags:
    - tests
    - unit
    - bluetooth
    - sensor
    - environmental

tests:
  # Basic test suite - runs on native simulation
  thingy52.env_monitor.tests.basic:
    platform_allow:
      - native_sim
      - native_sim/native/64
    integration_platforms:
      - native_sim
    tags:
      - sensor_manager
      - battery_service
      - ess_service

  # Sensor manager tests
  thingy52.env_monitor.tests.sensor_manager:
    platform_allow:
      - native_sim
      - native_sim/native/64
    integration_platforms:
      - native_sim
    extra_configs:
      - CONFIG_ZTEST_VERBOSE_OUTPUT=y
    tags:
      - sensor_manager
      - i2c_mock
      - gpio_mock

  # BLE service tests
  thingy52.env_monitor.tests.ble_services:
    platform_allow:
      - native_sim
      - native_sim/native/64
    integration_platforms:
      - native_sim
    extra_configs:
      - CONFIG_ZTEST_VERBOSE_OUTPUT=y
    tags:
      - ble_services
      - ess_service
      - battery_service

  # Mock validation tests
  thingy52.env_monitor.tests.mocks:
    platform_allow:
      - native_sim
      - native_sim/native/64
    integration_platforms:
      - native_sim
    extra_configs:
      - CONFIG_ZTEST_VERBOSE_OUTPUT=y
      - CONFIG_ZTEST_MOCKING=y
    tags:
      - mocks
      - i2c_mock
      - gpio_mock
      - bluetooth_mock

  # Sensor manager policy validation tests
  thingy52.env_monitor.tests.sensor_manager_policy:
    platform_allow:
      - native_sim
      - native_sim/native/64
    integration_platforms:
      - native_sim
    extra_configs:
      - CONFIG_ZTEST_VERBOSE_OUTPUT=y
    tags:
      - sensor_manager_policy
      - aq_divisor
      - ccs811_validation
      - sensor_data
```

## app/tests/unit/device_naming/testcase.yaml
```yaml
common:
  tags:
    - unit
    - device_naming

tests:
  thingy52.env_monitor.unit.device_naming:
    platform_allow:
      - native_sim
      - native_sim/native/64
    integration_platforms:
      - native_sim
    harness: ztest
```

## app/tests/unit/ess_encode/testcase.yaml
```yaml
common:
  tags:
    - unit
    - ess_encode

tests:
  thingy52.env_monitor.unit.ess_encode:
    platform_allow:
      - native_sim
      - native_sim/native/64
    integration_platforms:
      - native_sim
    harness: ztest
```

## app/tests/unit/ess_service/testcase.yaml
```yaml
common:
  tags:
    - unit
    - ess_service

tests:
  thingy52.env_monitor.unit.ess_service:
    platform_allow:
      - native_sim
      - native_sim/native/64
    integration_platforms:
      - native_sim
    harness: ztest
```

## app/tests/unit/sensor_manager_policy/testcase.yaml
```yaml
common:
  tags:
    - unit
    - sensor_manager

tests:
  thingy52.env_monitor.unit.sensor_manager_policy:
    platform_allow:
      - native_sim
      - native_sim/native/64
    integration_platforms:
      - native_sim
    harness: ztest
```

## app/tests/unit/uptime_service/testcase.yaml
```yaml
common:
  tags:
    - unit
    - uptime_service

tests:
  thingy52.env_monitor.unit.uptime_service:
    platform_allow:
      - native_sim
      - native_sim/native/64
    integration_platforms:
      - native_sim
    harness: ztest
```
