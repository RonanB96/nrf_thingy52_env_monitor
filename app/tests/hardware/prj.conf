## CMakeLists.txt
```
#
# Copyright (c) 2024 Nordic Semiconductor ASA
#
# SPDX-License-Identifier: LicenseRef-Nordic-5-Clause
#
cmake_minimum_required(VERSION 3.20.0)

find_package(Zephyr REQUIRED HINTS $ENV{ZEPHYR_BASE})
project(thingy52_hil_sensors)

target_sources(app PRIVATE
    src/test_hil_hts221.c
    src/test_hil_lps22hb.c
    src/test_hil_ccs811.c
    src/test_hil_battery.c
    src/test_hil_power_rails.c
)

target_include_directories(app PRIVATE
    src
    ${ZEPHYR_BASE}/drivers/sensor/st/lps22hb
)
```

## prj.conf
```kconfig
# ZTEST framework
CONFIG_ZTEST=y
CONFIG_ZTEST_VERBOSE_OUTPUT=y

# Logging via UART (needed to see ZTEST output)
CONFIG_LOG=y
CONFIG_LOG_BACKEND_UART=y
CONFIG_LOG_DEFAULT_LEVEL=3
CONFIG_LOG_MODE_IMMEDIATE=y

# Floating point support for sensor_value_to_double()
CONFIG_FPU=y
CONFIG_CBPRINTF_FP_SUPPORT=y

# Hardware drivers — specific drivers auto-selected by DT status=okay nodes
CONFIG_SENSOR=y
CONFIG_I2C=y
CONFIG_GPIO=y
CONFIG_ADC=y

# HTS221 DRDY trigger via GPIO interrupt (exercises GPIO interrupt path)
CONFIG_HTS221_TRIGGER_GLOBAL_THREAD=y

# Stack / heap sizing
CONFIG_MAIN_STACK_SIZE=4096
CONFIG_SYSTEM_WORKQUEUE_STACK_SIZE=4096
CONFIG_HEAP_MEM_POOL_SIZE=8192
```

## boards/thingy52.overlay
```dts
../../../boards/thingy52.overlay
```

## src/test_hil_battery.c
```c
/*
 * Copyright (c) 2024 Nordic Semiconductor ASA
 *
 * SPDX-License-Identifier: LicenseRef-Nordic-5-Clause
 */

#include <zephyr/ztest.h>
#include <zephyr/drivers/sensor.h>
#include <zephyr/logging/log.h>

LOG_MODULE_REGISTER(test_hil_battery, LOG_LEVEL_INF);

ZTEST_SUITE(hil_battery, NULL, NULL, NULL, NULL, NULL);

/*
 * Battery ADC path: vbatt voltage-divider node uses SAADC AIN4 (P0.28) with
 * BAT_MON_EN power gate (SX1509B pin 4). Tests that the full ADC chain works.
 */
ZTEST(hil_battery, test_vbatt_adc)
{
	const struct device *dev = DEVICE_DT_GET(DT_PATH(vbatt));

	zassert_true(device_is_ready(dev), "vbatt voltage-divider not ready");
	zassert_ok(sensor_sample_fetch(dev), "vbatt sample fetch failed");

	struct sensor_value voltage;

	zassert_ok(sensor_channel_get(dev, SENSOR_CHAN_VOLTAGE, &voltage),
		   "vbatt channel get failed");

	/* voltage-divider driver reports in volts; LiPo range 3.0–4.3 V */
	double v = sensor_value_to_double(&voltage);

	LOG_INF("Battery voltage: %.3f V", v);
	zassert_true(v > 3.0 && v < 4.3, "Battery voltage %.3f V out of range (3.0..4.3)", v);
}
```

## src/test_hil_ccs811.c
```c
/*
 * Copyright (c) 2024 Nordic Semiconductor ASA
 *
 * SPDX-License-Identifier: LicenseRef-Nordic-5-Clause
 */

#include <zephyr/ztest.h>
#include <zephyr/drivers/sensor.h>
#include <zephyr/logging/log.h>

LOG_MODULE_REGISTER(test_hil_ccs811, LOG_LEVEL_INF);

ZTEST_SUITE(hil_ccs811, NULL, NULL, NULL, NULL, NULL);

ZTEST(hil_ccs811, test_i2c_present)
{
	const struct device *dev = DEVICE_DT_GET(DT_NODELABEL(ccs811));

	/*
	 * CCS811 requires a 20-minute conditioning period before producing
	 * valid CO2/TVOC readings. sensor_sample_fetch() returns -EAGAIN
	 * when data is not yet ready — this is expected and proves the chip
	 * is present and ACKing on I2C. Any other negative return code
	 * indicates a hardware or bus failure.
	 */
	zassert_true(device_is_ready(dev), "CCS811 not ready");

	int rc = sensor_sample_fetch(dev);

	zassert_true(rc == 0 || rc == -EAGAIN,
		     "CCS811 I2C fetch failed (rc=%d) — chip not responding", rc);
	LOG_INF("CCS811 fetch rc=%d (%s)", rc, rc == 0 ? "data ready" : "conditioning");
}
```

## src/test_hil_hts221.c
```c
/*
 * Copyright (c) 2024 Nordic Semiconductor ASA
 *
 * SPDX-License-Identifier: LicenseRef-Nordic-5-Clause
 */

#include <zephyr/ztest.h>
#include <zephyr/drivers/sensor.h>
#include <zephyr/kernel.h>
#include <zephyr/logging/log.h>

LOG_MODULE_REGISTER(test_hil_hts221, LOG_LEVEL_INF);

ZTEST_SUITE(hil_hts221, NULL, NULL, NULL, NULL, NULL);

ZTEST(hil_hts221, test_temperature_in_range)
{
	const struct device *dev = DEVICE_DT_GET(DT_NODELABEL(hts221));

	zassert_true(device_is_ready(dev), "HTS221 not ready");
	zassert_ok(sensor_sample_fetch(dev), "HTS221 sample fetch failed");

	struct sensor_value temp;

	zassert_ok(sensor_channel_get(dev, SENSOR_CHAN_AMBIENT_TEMP, &temp),
		   "HTS221 temperature read failed");

	double t = sensor_value_to_double(&temp);

	LOG_INF("HTS221 temperature: %.2f C", t);
	zassert_true(t > 0.0 && t < 50.0, "Temperature %.2f C out of range (0..50)", t);
}

ZTEST(hil_hts221, test_humidity_in_range)
{
	const struct device *dev = DEVICE_DT_GET(DT_NODELABEL(hts221));

	zassert_true(device_is_ready(dev), "HTS221 not ready");
	zassert_ok(sensor_sample_fetch(dev), "HTS221 sample fetch failed");

	struct sensor_value humid;

	zassert_ok(sensor_channel_get(dev, SENSOR_CHAN_HUMIDITY, &humid),
		   "HTS221 humidity read failed");

	double h = sensor_value_to_double(&humid);

	LOG_INF("HTS221 humidity: %.2f %%", h);
	zassert_true(h >= 0.0 && h <= 100.0, "Humidity %.2f %% out of range (0..100)", h);
}

static struct k_sem hts221_drdy_sem;

static void hts221_drdy_handler(const struct device *dev, const struct sensor_trigger *trig)
{
	ARG_UNUSED(dev);
	ARG_UNUSED(trig);
	k_sem_give(&hts221_drdy_sem);
}

ZTEST(hil_hts221, test_drdy_trigger)
{
	const struct device *dev = DEVICE_DT_GET(DT_NODELABEL(hts221));
	struct sensor_trigger trig = {
		.type = SENSOR_TRIG_DATA_READY,
		.chan = SENSOR_CHAN_ALL,
	};

	zassert_true(device_is_ready(dev), "HTS221 not ready");

	k_sem_init(&hts221_drdy_sem, 0, 1);

	zassert_ok(sensor_trigger_set(dev, &trig, hts221_drdy_handler),
		   "Failed to set HTS221 DRDY trigger");

	int ret = k_sem_take(&hts221_drdy_sem, K_MSEC(2000));

	/* Deregister before asserting so no callback fires after the test exits */
	sensor_trigger_set(dev, &trig, NULL);

	zassert_equal(ret, 0, "HTS221 DRDY interrupt did not fire within 2s");
	LOG_INF("HTS221 DRDY trigger fired");
}
```

## src/test_hil_lps22hb.c
```c
/*
 * Copyright (c) 2024 Nordic Semiconductor ASA
 *
 * SPDX-License-Identifier: LicenseRef-Nordic-5-Clause
 */

#include <zephyr/ztest.h>
#include <zephyr/drivers/sensor.h>
#include <zephyr/drivers/gpio.h>
#include <zephyr/drivers/i2c.h>
#include <zephyr/kernel.h>
#include <zephyr/logging/log.h>
#include "lps22hb.h"

LOG_MODULE_REGISTER(test_hil_lps22hb, LOG_LEVEL_INF);

ZTEST_SUITE(hil_lps22hb, NULL, NULL, NULL, NULL, NULL);

ZTEST(hil_lps22hb, test_pressure_in_range)
{
	const struct device *dev = DEVICE_DT_GET(DT_NODELABEL(lps22hb_press));

	zassert_true(device_is_ready(dev), "LPS22HB not ready");
	zassert_ok(sensor_sample_fetch(dev), "LPS22HB sample fetch failed");

	struct sensor_value press;

	zassert_ok(sensor_channel_get(dev, SENSOR_CHAN_PRESS, &press),
		   "LPS22HB pressure read failed");

	/* Zephyr reports pressure in kPa; plausible range is 90–115 kPa */
	double p = sensor_value_to_double(&press);

	LOG_INF("LPS22HB pressure: %.2f kPa", p);
	zassert_true(p > 90.0 && p < 115.0, "Pressure %.2f kPa out of range (90..115)", p);
}

/*
 * LPS22HB DRDY interrupt path (P0.23).
 * The production driver uses a raw gpio_add_callback on this pin — not the
 * Zephyr sensor trigger API. This test exercises that same GPIO interrupt path
 * by triggering a one-shot conversion and waiting for the DRDY edge.
 */
static struct k_sem lps22hb_drdy_sem;

static void lps22hb_int_cb(const struct device *port, struct gpio_callback *cb, uint32_t pins)
{
	ARG_UNUSED(port);
	ARG_UNUSED(cb);
	ARG_UNUSED(pins);
	k_sem_give(&lps22hb_drdy_sem);
}

ZTEST(hil_lps22hb, test_drdy_interrupt)
{
	const struct device *i2c = DEVICE_DT_GET(DT_NODELABEL(i2c0));
	static const struct gpio_dt_spec int_pin =
		GPIO_DT_SPEC_GET(DT_NODELABEL(lps22hb_int), gpios);
	static struct gpio_callback gpio_cb;

	zassert_true(device_is_ready(i2c), "I2C0 not ready");
	zassert_true(device_is_ready(int_pin.port), "GPIO not ready");

	k_sem_init(&lps22hb_drdy_sem, 0, 1);

	zassert_ok(gpio_pin_configure_dt(&int_pin, GPIO_INPUT), "GPIO configure failed");
	gpio_init_callback(&gpio_cb, lps22hb_int_cb, BIT(int_pin.pin));
	zassert_ok(gpio_add_callback(int_pin.port, &gpio_cb), "GPIO add callback failed");
	zassert_ok(gpio_pin_interrupt_configure_dt(&int_pin, GPIO_INT_EDGE_RISING),
		   "GPIO interrupt configure failed");

	/* Read-modify-write: set only the bits we need, preserve driver-configured bits */
	uint8_t ctrl3_orig = 0;
	uint8_t ctrl2_orig = 0;
	uint8_t addr = DT_REG_ADDR(DT_NODELABEL(lps22hb_press));

	zassert_ok(i2c_reg_read_byte(i2c, addr, LPS22HB_REG_CTRL_REG3, &ctrl3_orig),
		   "LPS22HB CTRL_REG3 read failed");
	zassert_ok(i2c_reg_read_byte(i2c, addr, LPS22HB_REG_CTRL_REG2, &ctrl2_orig),
		   "LPS22HB CTRL_REG2 read failed");

	zassert_ok(i2c_reg_write_byte(i2c, addr, LPS22HB_REG_CTRL_REG3,
				      ctrl3_orig | LPS22HB_MASK_CTRL_REG3_DRDY),
		   "LPS22HB CTRL_REG3 write failed");
	zassert_ok(i2c_reg_write_byte(i2c, addr, LPS22HB_REG_CTRL_REG2,
				      ctrl2_orig | LPS22HB_MASK_CTRL_REG2_ONE_SHOT),
		   "LPS22HB one-shot trigger failed");

	int ret = k_sem_take(&lps22hb_drdy_sem, K_MSEC(500));

	gpio_pin_interrupt_configure_dt(&int_pin, GPIO_INT_DISABLE);
	gpio_remove_callback(int_pin.port, &gpio_cb);
	/* Restore registers to state the Zephyr driver left them in */
	i2c_reg_write_byte(i2c, addr, LPS22HB_REG_CTRL_REG3, ctrl3_orig);
	i2c_reg_write_byte(i2c, addr, LPS22HB_REG_CTRL_REG2,
			   ctrl2_orig & ~LPS22HB_MASK_CTRL_REG2_ONE_SHOT);

	zassert_equal(ret, 0, "LPS22HB DRDY interrupt on P0.23 did not fire within 500ms");
	LOG_INF("LPS22HB DRDY interrupt fired");
}
```

## src/test_hil_power_rails.c
```c
/*
 * Copyright (c) 2024 Nordic Semiconductor ASA
 *
 * SPDX-License-Identifier: LicenseRef-Nordic-5-Clause
 */

#include <zephyr/ztest.h>
#include <zephyr/drivers/gpio.h>
#include <zephyr/logging/log.h>

LOG_MODULE_REGISTER(test_hil_power_rails, LOG_LEVEL_INF);

ZTEST_SUITE(hil_power_rails, NULL, NULL, NULL, NULL, NULL);

/*
 * Power rail verification: MPU and microphone power must be off.
 * The app initialises SX1509B with init-out-low for pins 8 (MPU_PWR_CTRL)
 * and 9 (MIC_PWR_CTRL) and nothing in the test suite enables them.
 * gpio_pin_get_raw reads the SX1509B DATA register directly from hardware.
 */
ZTEST(hil_power_rails, test_sx1509b_mpu_mic_off)
{
	const struct device *sx = DEVICE_DT_GET(DT_NODELABEL(sx1509b));

	zassert_true(device_is_ready(sx), "SX1509B not ready");

	int mpu = gpio_pin_get_raw(sx, 8);
	int mic = gpio_pin_get_raw(sx, 9);

	LOG_INF("SX1509B pin8 (MPU_PWR_CTRL)=%d  pin9 (MIC_PWR_CTRL)=%d", mpu, mic);
	zassert_true(mpu >= 0, "MPU_PWR_CTRL (pin 8) GPIO read failed (err=%d)", mpu);
	zassert_equal(mpu, 0, "MPU_PWR_CTRL (pin 8) should be LOW — device must stay powered off");
	zassert_true(mic >= 0, "MIC_PWR_CTRL (pin 9) GPIO read failed (err=%d)", mic);
	zassert_equal(mic, 0, "MIC_PWR_CTRL (pin 9) should be LOW — device must stay powered off");
}
```
