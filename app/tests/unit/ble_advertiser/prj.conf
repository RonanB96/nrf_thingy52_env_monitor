## CMakeLists.txt
```
# Copyright (c) 2026 Eaton
# SPDX-License-Identifier: LicenseRef-Nordic-5-Clause
cmake_minimum_required(VERSION 3.20.0)

find_package(Zephyr REQUIRED HINTS $ENV{ZEPHYR_BASE})
project(unit_ble_advertiser)

# Shared FFF globals.
add_subdirectory(${CMAKE_SOURCE_DIR}/../common/mocks mocks)

set(APP_SRC ${CMAKE_SOURCE_DIR}/../../../src)
set(APP_INC ${CMAKE_SOURCE_DIR}/../../../include)

target_sources(app PRIVATE
	src/test_ble_advertiser.c
	src/mock_ble.c
	src/fake_deps.c
	${APP_SRC}/ble_advertiser.c
)

target_include_directories(app PRIVATE
	src
	${APP_INC}
)

target_link_libraries(app PRIVATE app_test_mocks)

# ble_advertiser.c uses snprintf via <stdio.h> indirectly through Zephyr's
# default libc auto-include chain. Under CONFIG_EXTERNAL_LIBC=y on the
# unit-test target, that chain doesn't fire, so force-include stdio.h
# only for this translation unit. Production builds are unaffected.
set_source_files_properties(
	${APP_SRC}/ble_advertiser.c
	PROPERTIES COMPILE_OPTIONS "-include;stdio.h"
)
```

## prj.conf
```kconfig
# Unit test for app/src/ble_advertiser.c with FFF mocks for the BT host
# and hwinfo APIs. Runs on native_sim. Same pattern as other unit tests
# in this repo (e.g. unit/ess_service): CONFIG_BT=n keeps the BT subsystem
# out of the link; the wrapper symbols are provided by mock_ble.c.

CONFIG_ZTEST=y
CONFIG_ZTEST_VERBOSE_OUTPUT=y

CONFIG_EXTERNAL_LIBC=y
CONFIG_USERSPACE=n

CONFIG_HEAP_MEM_POOL_SIZE=8192
CONFIG_MAIN_STACK_SIZE=4096

CONFIG_BT=n
CONFIG_HWINFO=n
CONFIG_SENSOR=n
CONFIG_GPIO=n
CONFIG_I2C=n
CONFIG_SPI=n
CONFIG_PM=n

CONFIG_LOG=y
CONFIG_LOG_MODE_IMMEDIATE=y
CONFIG_LOG_DEFAULT_LEVEL=2
```

## src/fake_deps.c
```c
/*
 * Copyright (c) 2026 Eaton
 * SPDX-License-Identifier: LicenseRef-Nordic-5-Clause
 *
 * In-app dependency fakes for ble_advertiser unit test.
 */

#include <stddef.h>
#include <string.h>
#include "device_naming.h"
#include "sensor_manager.h"

int device_naming_init(void)
{
	return 0;
}

int device_naming_get_name(char *buffer, size_t buffer_size)
{
	if (buffer == NULL || buffer_size == 0) {
		return -1;
	}
	const char *name = "thingy52-TEST0001";
	size_t n = strlen(name);
	if (n >= buffer_size) {
		n = buffer_size - 1;
	}
	memcpy(buffer, name, n);
	buffer[n] = '\0';
	return 0;
}

int sensor_manager_on_connected(void)
{
	return 0;
}

void sensor_manager_on_disconnected(void)
{
}

int ble_battery_service_on_connected(void)
{
	return 0;
}

void ble_battery_service_on_disconnected(void)
{
}
```

## src/mock_ble.c
```c
/*
 * Copyright (c) 2026 Eaton
 * SPDX-License-Identifier: LicenseRef-Nordic-5-Clause
 *
 * FFF fakes for the small slice of the BT host + hwinfo API consumed by
 * app/src/ble_advertiser.c. CONFIG_BT=n means the real symbols are not
 * compiled in, so these provide them.
 */

#include <zephyr/fff.h>
#include <zephyr/bluetooth/bluetooth.h>
#include <zephyr/bluetooth/conn.h>
#include <zephyr/drivers/hwinfo.h>
#include <stddef.h>
#include <string.h>

#include "mock_ble.h"

DEFINE_FAKE_VALUE_FUNC(int, bt_enable, bt_ready_cb_t);
DEFINE_FAKE_VALUE_FUNC(int, bt_le_adv_start, const struct bt_le_adv_param *, const struct bt_data *,
		       size_t, const struct bt_data *, size_t);
DEFINE_FAKE_VALUE_FUNC(int, bt_le_adv_stop);
DEFINE_FAKE_VALUE_FUNC(int, bt_conn_cb_register, struct bt_conn_cb *);
DEFINE_FAKE_VALUE_FUNC(int, bt_id_create, bt_addr_le_t *, uint8_t *);
/* hwinfo_get_device_id is a Zephyr syscall: production code calls the
 * static-inline wrapper from <zephyr/syscalls/hwinfo.h> which dispatches
 * to z_impl_hwinfo_get_device_id. Fake the impl symbol.
 */
DEFINE_FAKE_VALUE_FUNC(ssize_t, z_impl_hwinfo_get_device_id, uint8_t *, size_t);

/* Default custom_fake for bt_enable: invoke the ready callback synchronously
 * with err=0, mirroring the behaviour ble_advertiser.c expects.
 */
int mock_ble_enable_success(bt_ready_cb_t cb)
{
	if (cb != NULL) {
		cb(0);
	}
	return 0;
}

int mock_ble_enable_failure(bt_ready_cb_t cb)
{
	(void)cb;
	return -EIO;
}

ssize_t mock_hwinfo_zero_id(uint8_t *buf, size_t length)
{
	if (buf != NULL && length > 0) {
		memset(buf, 0, length);
	}
	return (ssize_t)length;
}

void mock_ble_reset(void)
{
	RESET_FAKE(bt_enable);
	RESET_FAKE(bt_le_adv_start);
	RESET_FAKE(bt_le_adv_stop);
	RESET_FAKE(bt_conn_cb_register);
	RESET_FAKE(bt_id_create);
	RESET_FAKE(z_impl_hwinfo_get_device_id);

	bt_enable_fake.custom_fake = mock_ble_enable_success;
	bt_id_create_fake.return_val = BT_ID_DEFAULT;
	z_impl_hwinfo_get_device_id_fake.custom_fake = mock_hwinfo_zero_id;
}
```

## src/mock_ble.h
```c
/*
 * Copyright (c) 2026 Eaton
 * SPDX-License-Identifier: LicenseRef-Nordic-5-Clause
 */

#ifndef MOCK_BLE_H_
#define MOCK_BLE_H_

#include <zephyr/fff.h>
#include <zephyr/bluetooth/bluetooth.h>
#include <zephyr/bluetooth/conn.h>
#include <zephyr/drivers/hwinfo.h>

DECLARE_FAKE_VALUE_FUNC(int, bt_enable, bt_ready_cb_t);
DECLARE_FAKE_VALUE_FUNC(int, bt_le_adv_start, const struct bt_le_adv_param *,
			const struct bt_data *, size_t, const struct bt_data *, size_t);
DECLARE_FAKE_VALUE_FUNC(int, bt_le_adv_stop);
DECLARE_FAKE_VALUE_FUNC(int, bt_conn_cb_register, struct bt_conn_cb *);
DECLARE_FAKE_VALUE_FUNC(int, bt_id_create, bt_addr_le_t *, uint8_t *);
DECLARE_FAKE_VALUE_FUNC(ssize_t, z_impl_hwinfo_get_device_id, uint8_t *, size_t);

int mock_ble_enable_success(bt_ready_cb_t cb);
int mock_ble_enable_failure(bt_ready_cb_t cb);
ssize_t mock_hwinfo_zero_id(uint8_t *buf, size_t length);
void mock_ble_reset(void);

#endif /* MOCK_BLE_H_ */
```

## src/test_ble_advertiser.c
```c
/*
 * Copyright (c) 2026 Eaton
 * SPDX-License-Identifier: LicenseRef-Nordic-5-Clause
 *
 * Unit test for app/src/ble_advertiser.c.
 *
 * Drives the public API against FFF fakes for bt_enable / bt_le_adv_*
 * and hwinfo_get_device_id. The default bt_enable fake invokes the
 * production module's ready callback synchronously so ble_advertiser_start
 * can take the bt_ready_sem without timing out.
 */

#include <zephyr/ztest.h>
#include <errno.h>

#include "ble_advertiser.h"
#include "mock_ble.h"

static struct ble_sensor_data fake_sensor_data = {
	.temperature = 2050,
	.humidity = 4500,
	.pressure = 10130,
	.eco2 = 420,
	.tvoc = 5,
	.battery_level = 87,
	.battery_charging = 0,
};

static void test_setup(void *fixture)
{
	ARG_UNUSED(fixture);
	mock_ble_reset();
}

ZTEST(ble_advertiser, test_init_success)
{
	int ret = ble_advertiser_init();
	zassert_ok(ret, "ble_advertiser_init: %d", ret);
	zassert_equal(bt_id_create_fake.call_count, 1, "bt_id_create not called");
	zassert_equal(bt_enable_fake.call_count, 1, "bt_enable not called");
	zassert_equal(bt_conn_cb_register_fake.call_count, 1, "bt_conn_cb_register not called");
}

ZTEST(ble_advertiser, test_init_bt_enable_failure)
{
	bt_enable_fake.custom_fake = mock_ble_enable_failure;

	int ret = ble_advertiser_init();
	zassert_equal(ret, -EIO, "expected -EIO from bt_enable failure, got %d", ret);
	zassert_equal(bt_conn_cb_register_fake.call_count, 0,
		      "conn_cb_register should not run after bt_enable failure");
}

ZTEST(ble_advertiser, test_start_null_data)
{
	int ret = ble_advertiser_start(NULL);
	zassert_equal(ret, -EINVAL, "expected -EINVAL, got %d", ret);
	zassert_equal(bt_le_adv_start_fake.call_count, 0,
		      "adv_start should not be called for NULL data");
}

ZTEST(ble_advertiser, test_start_success_after_init)
{
	zassert_ok(ble_advertiser_init(), "init must succeed first");

	int ret = ble_advertiser_start(&fake_sensor_data);
	zassert_ok(ret, "ble_advertiser_start: %d", ret);
	zassert_true(bt_le_adv_start_fake.call_count >= 1, "adv_start should have been called");
}

ZTEST(ble_advertiser, test_start_retries_on_eagain)
{
	zassert_ok(ble_advertiser_init(), "init must succeed first");

	/* First two attempts return EAGAIN, third succeeds. The production
	 * code retries up to 5 times with backoff.
	 */
	int return_seq[] = {-EAGAIN, -EAGAIN, 0};
	SET_RETURN_SEQ(bt_le_adv_start, return_seq, ARRAY_SIZE(return_seq));

	int ret = ble_advertiser_start(&fake_sensor_data);
	zassert_ok(ret, "expected eventual success after EAGAIN retries, got %d", ret);
	zassert_equal(bt_le_adv_start_fake.call_count, 3, "expected 3 adv_start attempts, got %u",
		      (unsigned)bt_le_adv_start_fake.call_count);
}

ZTEST(ble_advertiser, test_start_aborts_on_einval)
{
	zassert_ok(ble_advertiser_init(), "init must succeed first");

	bt_le_adv_start_fake.return_val = -EINVAL;

	int ret = ble_advertiser_start(&fake_sensor_data);
	zassert_equal(ret, -EINVAL, "expected EINVAL bubble-up, got %d", ret);
	zassert_equal(bt_le_adv_start_fake.call_count, 1,
		      "EINVAL should not retry, got %u attempts",
		      (unsigned)bt_le_adv_start_fake.call_count);
}

ZTEST(ble_advertiser, test_stop_idempotent)
{
	zassert_ok(ble_advertiser_init(), "init must succeed first");

	/* Two stops in a row must succeed; the production module short-circuits
	 * the second one when advertising_enabled is already false.
	 */
	zassert_ok(ble_advertiser_stop(), "first stop");
	uint32_t after_first = bt_le_adv_stop_fake.call_count;
	zassert_ok(ble_advertiser_stop(), "second stop");
	zassert_equal(bt_le_adv_stop_fake.call_count, after_first, "second stop should be a no-op");
}

ZTEST(ble_advertiser, test_full_cycle_start_stop)
{
	zassert_ok(ble_advertiser_init(), "init");
	zassert_ok(ble_advertiser_start(&fake_sensor_data), "start");
	zassert_ok(ble_advertiser_stop(), "stop");
	zassert_true(bt_le_adv_stop_fake.call_count >= 1,
		     "stop should reach the BT layer once advertising was active");
}

ZTEST_SUITE(ble_advertiser, NULL, NULL, test_setup, NULL, NULL);
```
